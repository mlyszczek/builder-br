## package/embedlog/Config.in
```kconfig
config BR2_PACKAGE_EMBEDLOG
	bool "embedlog"
	help
		Logger written in C89 targeting embedded systems.

		http://embedlog.kurwinet.pl
```

## package/librb/Config.in
```kconfig
config BR2_PACKAGE_LIBRB
	bool "librb"
	help
		librb is thread-safe, fast and easy to use ring buffer
		with interface similar to read/write from POSIX

		http://librb.kurwinet.pl
```
